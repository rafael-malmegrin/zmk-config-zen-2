## config/west.yml
```yaml
manifest:
  remotes:
    - name: rafaelromao
      url-base: https://github.com/rafaelromao
  projects:
    - name: zmk
      remote: rafaelromao
      revision: 20240328/rafaelromao/main
      import: app/west.yml
  self:
    path: config
```
